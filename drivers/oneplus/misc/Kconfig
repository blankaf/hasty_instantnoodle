## drivers/oneplus/misc/Kconfig
```kconfig
config PARAM_READ_WRITE
	bool "Param partition read/write support"
	default n
	help
		if you want to read/write the param partition in kernel,
		then you must say Y here.

config PROJECT_INFO
    bool "detect project info"
    default n
    help
      detect projcet info  If unsure, say n.

config OEM_BOOT_MODE
    bool "detect oem boot mode"
    default n
    help
        detect oem boot mode  If unsure, say y.
```
